## boards/shields/tanpa/Kconfig.defconfig
```kconfig
if SHIELD_TANPA_RIGHT

config ZMK_KEYBOARD_NAME
    default "Tanpa_R"

config ZMK_SPLIT
    default y

config ZMK_SPLIT_ROLE_CENTRAL
    default y

endif

if SHIELD_TANPA_LEFT

config ZMK_KEYBOARD_NAME
    default "Tanpa_L"

config ZMK_SPLIT
    default y

config ZMK_SPLIT_ROLE_CENTRAL
    default n

endif
```

## boards/shields/tanpa/Kconfig.shield
```kconfig
config SHIELD_TANPA_LEFT
    def_bool $(shields_list_contains, tanpa_left)

config SHIELD_TANPA_RIGHT
    def_bool $(shields_list_contains, tanpa_right)
```
